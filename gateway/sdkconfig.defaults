## gateway/sdkconfig.defaults
```kconfig
# Target
CONFIG_IDF_TARGET="esp32s3"

# Flash
CONFIG_ESPTOOLPY_FLASHSIZE_4MB=y
CONFIG_ESPTOOLPY_FLASHMODE_QIO=y

# Partition table
CONFIG_PARTITION_TABLE_CUSTOM=y
CONFIG_PARTITION_TABLE_CUSTOM_FILENAME="partitions.csv"
CONFIG_PARTITION_TABLE_OFFSET=0x8000
CONFIG_PARTITION_TABLE_MD5=y

# No PSRAM on WROOM-1
CONFIG_SPIRAM=n

# CPU
CONFIG_ESP_DEFAULT_CPU_FREQ_MHZ_240=y

# WiFi
CONFIG_ESP_WIFI_STATIC_RX_BUFFER_NUM=16
CONFIG_ESP_WIFI_DYNAMIC_RX_BUFFER_NUM=64
CONFIG_ESP_WIFI_DYNAMIC_TX_BUFFER_NUM=64

# HTTPD
CONFIG_HTTPD_MAX_REQ_HDR_LEN=1024
CONFIG_HTTPD_MAX_URI_LEN=512
CONFIG_HTTPD_WS_SUPPORT=y

# FreeRTOS
CONFIG_FREERTOS_HZ=1000

# Main task
CONFIG_ESP_MAIN_TASK_STACK_SIZE=4096
CONFIG_ESP_SYSTEM_EVENT_TASK_STACK_SIZE=4096

# Watchdog
CONFIG_ESP_TASK_WDT_TIMEOUT_S=10
CONFIG_ESP_TASK_WDT_PANIC=y

# OTA rollback
CONFIG_BOOTLOADER_APP_ROLLBACK_ENABLE=y

# Log — verbose for debugging Zigbee join issues
CONFIG_LOG_DEFAULT_LEVEL_INFO=y
CONFIG_LOG_MAXIMUM_LEVEL_DEBUG=y

# Zigbee NCP host mode
CONFIG_GW_ZIGBEE_CHANNEL=25

# NCP host UART configuration
CONFIG_HOST_BUS_MODE_UART=y
CONFIG_HOST_BUS_UART_NUM=1
CONFIG_HOST_BUS_UART_TX_PIN=18
CONFIG_HOST_BUS_UART_RX_PIN=17
CONFIG_HOST_BUS_UART_BAUD_RATE=460800

# lwIP
CONFIG_LWIP_LOCAL_HOSTNAME="zigbee-gw"
CONFIG_LWIP_IRAM_OPTIMIZATION=y
CONFIG_LWIP_TCP_SND_BUF_DEFAULT=11520
CONFIG_LWIP_TCP_WND_DEFAULT=11520

# Performance
CONFIG_UART_ISR_IN_IRAM=y
CONFIG_COMPILER_OPTIMIZATION_SIZE=y
CONFIG_SPI_FLASH_ERASE_YIELD_DURATION_MS=10
```

## main/Kconfig.projbuild
```kconfig
menu "Zigbee Gateway Configuration"

    config GW_WIFI_SSID
        string "Default WiFi SSID"
        default ""
        help
            WiFi SSID for station mode. Can be changed at runtime via web UI.

    config GW_WIFI_PASSWORD
        string "Default WiFi Password"
        default ""
        help
            WiFi password for station mode. Can be changed at runtime via web UI.

    config GW_ZIGBEE_CHANNEL
        int "Zigbee Channel (11-26, 0=auto)"
        default 0
        range 0 26

    config GW_MAX_DEVICES
        int "Maximum Zigbee devices"
        default 32
        range 8 64

    config GW_AP_PASSWORD
        string "AP mode WiFi password (min 8 chars for WPA2)"
        default "zigbee1234"
        help
            Password for the fallback AP mode. Must be at least 8 characters for WPA2.

    config GW_HTTP_PASSWORD
        string "Default HTTP admin password"
        default "admin"
        help
            Default password for HTTP Basic Auth on POST endpoints.
            Can be changed at runtime via web UI (stored in NVS).

endmenu
```

## ncp/sdkconfig.defaults
```kconfig
# Reduce bootloader log verbosity
CONFIG_BOOTLOADER_LOG_LEVEL_WARN=y
CONFIG_BOOTLOADER_LOG_LEVEL=2

# Increase main task stack size
CONFIG_ESP_MAIN_TASK_STACK_SIZE=7168

# Enable filesystem
CONFIG_PARTITION_TABLE_CUSTOM=y
CONFIG_PARTITION_TABLE_CUSTOM_FILENAME="partitions.csv"
CONFIG_PARTITION_TABLE_FILENAME="partitions.csv"

# Enable FreeRTOS stats formatting functions, needed for 'tasks' command
CONFIG_FREERTOS_USE_TRACE_FACILITY=y
CONFIG_FREERTOS_USE_STATS_FORMATTING_FUNCTIONS=y

# Zigbee
CONFIG_ZB_ENABLED=y
CONFIG_ZB_ZCZR=y

# Console via USB Serial/JTAG (free up UART0 pins for NCP)
CONFIG_ESP_CONSOLE_USB_SERIAL_JTAG=y

# NCP UART configuration (H2-MINI-1: UART0, TXD=GPIO24, RXD=GPIO23)
CONFIG_NCP_BUS_MODE_UART=y
CONFIG_NCP_BUS_UART_NUM=0
CONFIG_NCP_BUS_UART_TX_PIN=24
CONFIG_NCP_BUS_UART_RX_PIN=23
CONFIG_NCP_BUS_UART_BAUD_RATE=460800
```

## sdkconfig.defaults
```kconfig
# Target
CONFIG_IDF_TARGET="esp32s3"

# Flash
CONFIG_ESPTOOLPY_FLASHSIZE_4MB=y
CONFIG_ESPTOOLPY_FLASHMODE_QIO=y

# Partition table
CONFIG_PARTITION_TABLE_CUSTOM=y
CONFIG_PARTITION_TABLE_CUSTOM_FILENAME="partitions.csv"
CONFIG_PARTITION_TABLE_OFFSET=0x8000
CONFIG_PARTITION_TABLE_MD5=y

# No PSRAM on WROOM-1
CONFIG_SPIRAM=n

# CPU
CONFIG_ESP_DEFAULT_CPU_FREQ_MHZ_240=y

# WiFi
CONFIG_ESP_WIFI_STATIC_RX_BUFFER_NUM=16
CONFIG_ESP_WIFI_DYNAMIC_RX_BUFFER_NUM=64
CONFIG_ESP_WIFI_DYNAMIC_TX_BUFFER_NUM=64

# HTTPD
CONFIG_HTTPD_MAX_REQ_HDR_LEN=1024
CONFIG_HTTPD_MAX_URI_LEN=512
CONFIG_HTTPD_WS_SUPPORT=y

# FreeRTOS
CONFIG_FREERTOS_HZ=1000

# Main task
CONFIG_ESP_MAIN_TASK_STACK_SIZE=4096
CONFIG_ESP_SYSTEM_EVENT_TASK_STACK_SIZE=4096

# Watchdog
CONFIG_ESP_TASK_WDT_TIMEOUT_S=10
CONFIG_ESP_TASK_WDT_PANIC=y

# OTA rollback
CONFIG_BOOTLOADER_APP_ROLLBACK_ENABLE=y

# Log — verbose for debugging Zigbee join issues
CONFIG_LOG_DEFAULT_LEVEL_INFO=y
CONFIG_LOG_MAXIMUM_LEVEL_DEBUG=y

# Zigbee stack
CONFIG_ZB_ENABLED=y
CONFIG_ZB_ZCZR=y
CONFIG_ZB_DEBUG_MODE=y
CONFIG_GW_ZIGBEE_CHANNEL=25

# mbedTLS (needed for Zigbee)
CONFIG_MBEDTLS_HARDWARE_AES=n
CONFIG_MBEDTLS_HARDWARE_MPI=n
CONFIG_MBEDTLS_HARDWARE_SHA=n
CONFIG_MBEDTLS_CMAC_C=y
CONFIG_MBEDTLS_SSL_PROTO_DTLS=y
CONFIG_MBEDTLS_KEY_EXCHANGE_ECJPAKE=y
CONFIG_MBEDTLS_ECJPAKE_C=y

# RCP auto-update
CONFIG_ZIGBEE_GW_AUTO_UPDATE_RCP=y
CONFIG_PIN_TO_RCP_RESET=7
CONFIG_PIN_TO_RCP_BOOT=8
CONFIG_PIN_TO_RCP_TX=17
CONFIG_PIN_TO_RCP_RX=18

# lwIP
CONFIG_LWIP_LOCAL_HOSTNAME="zigbee-gw"
```
